## espfw/main/Kconfig.projbuild
```kconfig
menu "ZAMDACH2022 Configuration"

    config ZAMDACH_USEWIFI
        bool "Use WiFi instead of Ethernet"
        default n
        help
            If this is enabled, WiFi will be used for connecting
            to the internet instead of the Ethernet port. The
            ethernet port may still be used to provide PoE power
            in this case, but it does not have to.

    if ZAMDACH_USEWIFI
        config ZAMDACH_WIFISSID
            string "WiFi SSID to connect to"
            default "ZAM"
            help
                Sets the SSID to which we try to connect.
                Do not forget to set the secret (password) as well,
                you need to do that in secrets.h, not here.

    endif # ZAMDACH_USEWIFI

    config ZAMDACH_WPDSID_HUMIDITY
        string "wetter.p.d ID for the humidity sensor"
        default "19"
        help
            The ID of the humidity sensor for reporting
            to wetter.poempelfox.de

    config ZAMDACH_WPDSID_PRESSURE
        string "wetter.p.d ID for the pressure sensor"
        default "13"
        help
            The ID of the pressure sensor for reporting
            to wetter.poempelfox.de

    config ZAMDACH_WPDSID_RAINGAUGE1
        string "wetter.p.d ID for the RG15 raingauge"
        default "14"
        help
            The ID of the RG15 raingauge sensor for reporting
            to wetter.poempelfox.de

    config ZAMDACH_WPDSID_TEMPERATURE
        string "wetter.p.d ID for the temperature sensor"
        default "20"
        help
            The ID of the temperature sensor for reporting
            to wetter.poempelfox.de

    config ZAMDACH_WPDSID_UV
        string "wetter.p.d ID for the UV sensor"
        default "21"
        help
            The ID of the UV sensor for reporting
            to wetter.poempelfox.de

    config ZAMDACH_WPDSID_WINDDIR
        string "wetter.p.d ID for the wind vane (wind direction)"
        default "22"
        help
            The ID of the wind vane (wind direction) sensor for reporting
            to wetter.poempelfox.de

    config ZAMDACH_WPDSID_WINDSPEED
        string "wetter.p.d ID for the aenometer (wind speed)"
        default "23"
        help
            The ID of the aenometer (wind speed) sensor for reporting
            to wetter.poempelfox.de

    config ZAMDACH_WPDSID_WINDSPMAX
        string "wetter.p.d ID for the aenometer (max. wind speed)"
        default "77"
        help
            The ID of the aenometer (maximum wind speed) sensor for reporting
            to wetter.poempelfox.de

    config ZAMDACH_WPDSID_ILLUMINANCE
        string "wetter.p.d ID for the illuminance sensor"
        default "24"
        help
            The ID of the illuminance sensor for reporting
            to wetter.poempelfox.de

    config ZAMDACH_WPDSID_PM010
        string "wetter.p.d ID for the PM1.0 sensor"
        default "25"
        help
            The ID of the particulate matter 1.0 sensor for reporting
            to wetter.poempelfox.de

    config ZAMDACH_WPDSID_PM025
        string "wetter.p.d ID for the PM2.5 sensor"
        default "26"
        help
            The ID of the particulate matter 2.5 sensor for reporting
            to wetter.poempelfox.de

    config ZAMDACH_WPDSID_PM040
        string "wetter.p.d ID for the PM4.0 sensor"
        default "27"
        help
            The ID of the particulate matter 4.0 sensor for reporting
            to wetter.poempelfox.de

    config ZAMDACH_WPDSID_PM100
        string "wetter.p.d ID for the PM10.0 sensor"
        default "28"
        help
            The ID of the particulate matter 10.0 sensor for reporting
            to wetter.poempelfox.de

    config ZAMDACH_OSM_BOXID
        string "OpenSenseMap Box-ID"
        default "63b83dcc6795ba0007794c93"
        help
            The SenseBox-ID for reporting data to opensensemap.org

    config ZAMDACH_OSMSID_HUMIDITY
        string "opensensemap sensor-ID for the humidity sensor"
        default "63b83dcc6795ba0007794c9c"
        help
            The ID of the humidity sensor for reporting
            to opensensemap.org

    config ZAMDACH_OSMSID_PRESSURE
        string "opensensemap sensor-ID for the pressure sensor"
        default "63b83dcc6795ba0007794c9b"
        help
            The ID of the pressure sensor for reporting
            to opensensemap.org

    config ZAMDACH_OSMSID_RAINGAUGE1
        string "opensensemap sensor-ID for the RG15 raingauge"
        default "63b83dcc6795ba0007794c9e"
        help
            The ID of the RG15 raingauge sensor for reporting
            to opensensemap.org

    config ZAMDACH_OSMSID_TEMPERATURE
        string "opensensemap sensor-ID for the temperature sensor"
        default "63b83dcc6795ba0007794c9d"
        help
            The ID of the temperature sensor for reporting
            to opensensemap.org

    config ZAMDACH_OSMSID_UV
        string "opensensemap sensor-ID for the UV sensor"
        default "63b83dcc6795ba0007794c94"
        help
            The ID of the UV sensor for reporting
            to opensensemap.org

    config ZAMDACH_OSMSID_WINDDIR
        string "opensensemap sensor-ID for the wind vane (wind direction)"
        default "63b83dcc6795ba0007794c96"
        help
            The ID of the wind vane (wind direction) sensor for reporting
            to opensensemap.org

    config ZAMDACH_OSMSID_WINDSPEED
        string "opensensemap sensor-ID for the aenometer (wind speed)"
        default "63b83dcc6795ba0007794c97"
        help
            The ID of the aenometer (wind speed) sensor for reporting
            to opensensemap.org

    config ZAMDACH_OSMSID_WINDSPMAX
        string "opensensemap sensor-ID for the aenometer (max. wind speed)"
        default ""
        help
            The ID of the aenometer (maximum wind speed) sensor for reporting
            to opensensemap.org

    config ZAMDACH_OSMSID_ILLUMINANCE
        string "opensensemap sensor-ID for the illuminance sensor"
        default "63b83dcc6795ba0007794c95"
        help
            The ID of the illuminance sensor for reporting
            to opensensemap.org

    config ZAMDACH_OSMSID_PM010
        string "opensensemap sensor-ID for the PM1.0 sensor"
        default "63b83dcc6795ba0007794c9a"
        help
            The ID of the particulate matter 1.0 sensor for reporting
            to opensensemap.org

    config ZAMDACH_OSMSID_PM025
        string "opensensemap sensor-ID for the PM2.5 sensor"
        default "63b83dcc6795ba0007794c99"
        help
            The ID of the particulate matter 2.5 sensor for reporting
            to opensensemap.org

    config ZAMDACH_OSMSID_PM040
        string "opensensemap sensor-ID for the PM4.0 sensor"
        default ""
        help
            The ID of the particulate matter 4.0 sensor for reporting
            to opensensemap.org

    config ZAMDACH_OSMSID_PM100
        string "opensensemap sensor-ID for the PM10.0 sensor"
        default "63b83dcc6795ba0007794c98"
        help
            The ID of the particulate matter 10.0 sensor for reporting
            to opensensemap.org

endmenu
```

## espfw/sdkconfig.defaults
```kconfig
CONFIG_ESP_NETIF_TCPIP_ADAPTER_COMPATIBLE_LAYER=n
CONFIG_ESP_DEFAULT_CPU_FREQ_MHZ=80
CONFIG_BOOTLOADER_APP_ROLLBACK_ENABLE=y
CONFIG_ESPTOOLPY_FLASHSIZE_4MB=y
CONFIG_PARTITION_TABLE_TWO_OTA=y
CONFIG_TWAI_ERRATA_FIX_BUS_OFF_REC=n
CONFIG_TWAI_ERRATA_FIX_TX_INTR_LOST=n
CONFIG_TWAI_ERRATA_FIX_RX_FRAME_INVALID=n
CONFIG_TWAI_ERRATA_FIX_RX_FIFO_CORRUPT=n
CONFIG_ETH_RMII_CLK_OUTPUT=y
CONFIG_ETH_SPI_ETHERNET_W5500=y
CONFIG_ESP_HTTP_CLIENT_ENABLE_DIGEST_AUTH=y
CONFIG_HTTPD_MAX_REQ_HDR_LEN=1024
CONFIG_ESP_SLEEP_POWER_DOWN_FLASH=y
CONFIG_ESP_PHY_REDUCE_TX_POWER=y
CONFIG_ESP_DEFAULT_CPU_FREQ_MHZ_80=y
CONFIG_ESP_MAIN_TASK_STACK_SIZE=4352
CONFIG_ESP_BROWNOUT_DET_LVL_SEL_3=y
CONFIG_ESP_IPC_TASK_STACK_SIZE=1536
CONFIG_ESP_WIFI_STA_DISCONNECTED_PM_ENABLE=n
CONFIG_LWIP_LOCAL_HOSTNAME="zamdach2022"
CONFIG_LWIP_DHCPS=n
CONFIG_LWIP_IPV6_AUTOCONFIG=y
CONFIG_LWIP_IPV6_NUM_ADDRESSES=6
CONFIG_LWIP_SNTP_MAX_SERVERS=2
CONFIG_MBEDTLS_CERTIFICATE_BUNDLE_DEFAULT_CMN=y
CONFIG_WIFI_PROV_BLE_FORCE_ENCRYPTION=y
CONFIG_ZAMDACH_USEWIFI=n
CONFIG_ZAMDACH_WPDSID_PRESSURE="13"
CONFIG_ZAMDACH_WPDSID_RAINGAUGE1="14"
CONFIG_ZAMDACH_WPDSID_HUMIDITY="19"
CONFIG_ZAMDACH_WPDSID_TEMPERATURE="20"
CONFIG_ZAMDACH_WPDSID_UV="21"
CONFIG_ZAMDACH_WPDSID_WINDDIR="22"
CONFIG_ZAMDACH_WPDSID_WINDSPEED="23"
CONFIG_ZAMDACH_WPDSID_WINDSPMAX="77"
CONFIG_ZAMDACH_WPDSID_ILLUMINANCE="24"
CONFIG_ZAMDACH_WPDSID_PM010="25"
CONFIG_ZAMDACH_WPDSID_PM025="26"
CONFIG_ZAMDACH_WPDSID_PM040="27"
CONFIG_ZAMDACH_WPDSID_PM100="28"
CONFIG_ZAMDACH_OSM_BOXID="63b83dcc6795ba0007794c93"
CONFIG_ZAMDACH_OSMSID_HUMIDITY="63b83dcc6795ba0007794c9c"
CONFIG_ZAMDACH_OSMSID_PRESSURE="63b83dcc6795ba0007794c9b"
CONFIG_ZAMDACH_OSMSID_RAINGAUGE1="63b83dcc6795ba0007794c9e"
CONFIG_ZAMDACH_OSMSID_TEMPERATURE="63b83dcc6795ba0007794c9d"
CONFIG_ZAMDACH_OSMSID_UV="63b83dcc6795ba0007794c94"
CONFIG_ZAMDACH_OSMSID_WINDDIR="63b83dcc6795ba0007794c96"
CONFIG_ZAMDACH_OSMSID_WINDSPEED="63b83dcc6795ba0007794c97"
CONFIG_ZAMDACH_OSMSID_WINDSPMAX=""
CONFIG_ZAMDACH_OSMSID_ILLUMINANCE="63b83dcc6795ba0007794c95"
CONFIG_ZAMDACH_OSMSID_PM010="63b83dcc6795ba0007794c9a"
CONFIG_ZAMDACH_OSMSID_PM025="63b83dcc6795ba0007794c99"
CONFIG_ZAMDACH_OSMSID_PM040=""
CONFIG_ZAMDACH_OSMSID_PM100="63b83dcc6795ba0007794c98"
```
